## conf/distro/calaos.conf
```bitbake
DISTRO_NAME = "Calaos"
DISTRO_VERSION = "v1"
BUILDNAME = "Calaos ${DISTRO_VERSION}"
PACKAGE_CLASSES = "package_ipk"
DISTRO_FEATURES = "alsa ext2 largefile usbhost wifi xattr nfs zeroconf x11 ${DISTRO_FEATURES_LIBC} systemd"
VIRTUAL-RUNTIME_init_manager = "systemd"
```

## conf/distro/enna.conf
```bitbake
DISTRO = "enna"
DISTRO_NAME = "Enna (Build by Poky 7.0.1)"
DISTRO_VERSION = "1.0"
SDK_VENDOR = "-ennasdk"
SDK_VERSION := "${DISTRO_VERSION}"

MAINTAINER = "Nicolas Aguirre <aguirre.nicolas@gmail.com>"

TARGET_VENDOR = "-enna"

LOCALCONF_VERSION = "1"

DISTRO_FEATURES_append = " largefile opengl"

SDK_NAME = "${DISTRO}-${TCLIBC}-${SDK_ARCH}-${TARGET_ARCH}"
SDKPATH = "/opt/${DISTRO}/${SDK_VERSION}"

DISTRO_EXTRA_RDEPENDS += " "
DISTRO_EXTRA_RRECOMMENDS += " "

TCLIBCAPPEND = ""

PREMIRRORS ?= "\
bzr://.*/.*   http://downloads.yoctoproject.org/mirror/sources/ \n \
cvs://.*/.*   http://downloads.yoctoproject.org/mirror/sources/ \n \
git://.*/.*   http://downloads.yoctoproject.org/mirror/sources/ \n \
hg://.*/.*    http://downloads.yoctoproject.org/mirror/sources/ \n \
osc://.*/.*   http://downloads.yoctoproject.org/mirror/sources/ \n \
p4://.*/.*    http://downloads.yoctoproject.org/mirror/sources/ \n \
svk://.*/.*   http://downloads.yoctoproject.org/mirror/sources/ \n \
svn://.*/.*   http://downloads.yoctoproject.org/mirror/sources/ \n"

MIRRORS =+ "\
ftp://.*/.*      http://downloads.yoctoproject.org/mirror/sources/ \n \
http://.*/.*     http://downloads.yoctoproject.org/mirror/sources/ \n \
https://.*/.*    http://downloads.yoctoproject.org/mirror/sources/ \n"

# Default hash policy for distro
BB_SIGNATURE_HANDLER ?= 'OEBasicHash'
#
# OELAYOUT_ABI allows us to notify users when the format of TMPDIR changes in 
# an incompatible way. Such changes should usually be detailed in the commit
# that breaks the format and have been previously discussed on the mailing list 
# with general agreement from the core team.
#
OELAYOUT_ABI = "8"


# set feed path variables
FEED_BASEPATH = "feeds/v2012.05/${ANGSTROM_PKG_FORMAT}/${TCLIBC}/"

# Set DISTRO_FEED_CONFIGS to our config var, assigned in the above .inc
DISTRO_FEED_CONFIGS = "${ANGSTROM_FEED_CONFIGS}"
```

## conf/layer.conf
```bitbake
# We have a conf and classes directory, append to BBPATH
BBPATH .= ":${LAYERDIR}"

# We have a recipes directory, add to BBFILES
BBFILES += "${LAYERDIR}/recipes*/*/*.bb ${LAYERDIR}/recipes*/*/*.bbappend"

BBFILE_COLLECTIONS += "enna-layer"
BBFILE_PATTERN_enna-layer := "^${LAYERDIR}/"
BBFILE_PRIORITY_enna-layer = "7"
```
